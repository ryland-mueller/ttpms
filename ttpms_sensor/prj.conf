## CMakeLists.txt
```
# SPDX-License-Identifier: Apache-2.0

cmake_minimum_required(VERSION 3.20.0)

find_package(Zephyr REQUIRED HINTS $ENV{ZEPHYR_BASE})
project(none)

FILE(GLOB app_sources src/*.c)
target_sources(app PRIVATE ${app_sources})
```

## prj.conf
```kconfig
CONFIG_BT=y
CONFIG_BT_DEBUG_LOG=y
CONFIG_BT_PERIPHERAL=y
CONFIG_BT_DEVICE_NAME="TTPMS Sensor"
CONFIG_BT_DEVICE_NAME_DYNAMIC=y
CONFIG_BT_DEVICE_NAME_MAX=65
# 1362 = 0x0552     ->     Category: Sensor     Sub-Category: Multi-Sensor
CONFIG_BT_DEVICE_APPEARANCE=1362
CONFIG_BT_BUF_ACL_RX_SIZE=251
CONFIG_BT_BUF_ACL_TX_SIZE=251
CONFIG_BT_L2CAP_TX_MTU=247
CONFIG_BT_CTLR_DATA_LENGTH_MAX=251

# was crashing upon connection without the below line
CONFIG_BT_RX_STACK_SIZE=2048

# REMEMBER TO MESS AROUND WITH TX POWER TO SAVE ENERGY!

CONFIG_I2C=y

CONFIG_TINYCBOR=y
CONFIG_CBOR_FLOATING_POINT=y

#CONFIG_FP16=y  half-precision floating point, barely any documentation on this so sticking with int setup

CONFIG_LOG=y
CONFIG_LOG2_MODE_IMMEDIATE=y

CONFIG_DEBUG_OPTIMIZATIONS=y
CONFIG_DEBUG=y
CONFIG_HW_STACK_PROTECTION=y

#CONFIG_MAIN_STACK_SIZE=4096
#CONFIG_HEAP_MEM_POOL_SIZE=8192

# 32kHz clock source? (from BL653 github zephyr sample)
#CONFIG_CLOCK_CONTROL_NRF_K32SRC_XTAL=y
#CONFIG_CLOCK_CONTROL_NRF_K32SRC_20PPM=y

CONFIG_CBPRINTF_FP_SUPPORT=y
```

## src/main.c
```c
#include <zephyr.h>

#include <logging/log.h>
LOG_MODULE_REGISTER(TTPMS);

#include "ttpms_service.h"
#include "sensors.h"

/* size of stack area used by threads */
#define TEMP_STACKSIZE 4096
#define PRESSURE_STACKSIZE 1024

/* scheduling priority used by threads */
#define TEMP_PRIORITY 4			// should these be negative?
#define PRESSURE_PRIORITY 4

void main(void)
{
	LOG_INF("Running TTPMS Sensor on %s", CONFIG_BOARD);

	ttpms_service_init();	// start bluetooth
	i2c_init();				// set up I2C

}

void temp_update(void)
{
	while(1)
	{
		switch (temp_freq)
		{
			case 0x00: 	k_sleep(K_USEC(1000000 * 2)); 	break;	// 0.5Hz
			case 0x01: 	k_sleep(K_USEC(1000000)); 		break;	// 1Hz
			case 0x02: 	k_sleep(K_USEC(1000000 / 2)); 	break;	// 2Hz
			case 0x03: 	k_sleep(K_USEC(1000000 / 4)); 	break;	// 4Hz
			case 0x04: 	k_sleep(K_USEC(1000000 / 8)); 	break;	// 8Hz
			case 0x05: 	k_sleep(K_USEC(1000000 / 16)); 	break;	// 16Hz
			case 0x06: 	k_sleep(K_USEC(1000000 / 32)); 	break;	// 32Hz
			case 0x07:	k_sleep(K_USEC(1000000 / 64)); 	break;	// 64Hz
		}
		if (bitcheck(connection_status, 1)) {	// if we just connected, do connect procedure

			//LOG_INF("Running connect procedure");
			// set VREG enable pin HIGH
			k_sleep(K_MSEC(10));	// let MLX90641 start up, supposedly needs 5ms?
			MLX90641_init();
			bitclear(connection_status, 1);		// clear connect procedure required bit

		} else if (bitcheck(connection_status, 0)) {	// if connected, take reading and update over bluetooth

			//LOG_INF("Running active connection procedure");
			temp_read();
			ttpms_temp_notify();

		} else if (bitcheck(connection_status, 2)) {	// if we just disconnected, do disconnect procedure

			//LOG_INF("Running disconnect procedure");
			// set VREG enable pin LOW
			bitclear(connection_status, 2);		// clear disconnect procedure required bit

		}
		
	}
}

void pressure_update(void)
{
	while(1)
	{
		k_sleep(K_USEC(1000000 / pressure_freq));
		if (bitcheck(connection_status, 0))
		{
			pressure_read();
			ttpms_pressure_notify();
		}
	}
}

K_THREAD_DEFINE(temp_update_id, TEMP_STACKSIZE, temp_update, NULL, NULL, NULL,
				TEMP_PRIORITY, 0, 0);

K_THREAD_DEFINE(pressure_update_id, PRESSURE_STACKSIZE, pressure_update, NULL, NULL, NULL,
				PRESSURE_PRIORITY, 0, 0);
```

## src/MLX90641_API.h
```c
#ifndef _MLX90641_API_H_
#define _MLX90641_API_H_

#include <stdint.h>

#define SCALEALPHA 0.000001
    
  typedef struct
    {
        int16_t kVdd;
        int16_t vdd25;
        float KvPTAT;
        float KtPTAT;
        uint16_t vPTAT25;
        float alphaPTAT;
        int16_t gainEE;
        float tgc;
        float cpKv;
        float cpKta;
        uint8_t resolutionEE;
        uint8_t calibrationModeEE;
        float KsTa;
        float ksTo[8];
        int16_t ct[8];
        uint16_t alpha[192]; 
        uint8_t alphaScale;   
        int16_t offset[2][192];    
        int8_t kta[192];
        uint8_t ktaScale;    
        int8_t kv[192];
        uint8_t kvScale;
        float cpAlpha;
        int16_t cpOffset;
        float emissivityEE; 
        uint16_t brokenPixel;
    } paramsMLX90641;
    
    int MLX90641_DumpEE(uint8_t slaveAddr, uint16_t *eeData);
    int MLX90641_SynchFrame(uint8_t slaveAddr);
    int MLX90641_TriggerMeasurement(uint8_t slaveAddr);
    int MLX90641_GetFrameData(uint8_t slaveAddr, uint16_t *frameData);
    int MLX90641_ExtractParameters(uint16_t *eeData, paramsMLX90641 *mlx90641);
    float MLX90641_GetVdd(uint16_t *frameData, const paramsMLX90641 *params);
    float MLX90641_GetTa(uint16_t *frameData, const paramsMLX90641 *params);
    void MLX90641_GetImage(uint16_t *frameData, const paramsMLX90641 *params, float *result);
    void MLX90641_CalculateTo(uint16_t *frameData, const paramsMLX90641 *params, float emissivity, float tr, float *result);
    int MLX90641_SetResolution(uint8_t slaveAddr, uint8_t resolution);
    int MLX90641_GetCurResolution(uint8_t slaveAddr);
    int MLX90641_SetRefreshRate(uint8_t slaveAddr, uint8_t refreshRate);   
    int MLX90641_GetRefreshRate(uint8_t slaveAddr);  
    int MLX90641_GetSubPageNumber(uint16_t *frameData);
    float MLX90641_GetEmissivity(const paramsMLX90641 *mlx90641);
    void MLX90641_BadPixelsCorrection(uint16_t pixel, float *to);
    
#endif
```

## src/MLX90641_I2C_Driver.c
```c
#include <zephyr.h>
#include <errno.h>
#include <device.h>
#include <drivers/i2c.h>

#include <logging/log.h>
LOG_MODULE_DECLARE(TTPMS);

#include "MLX90641_I2C_Driver.h"
#include "sensors.h"

//const struct device *i2c_dev;

// this function should be moved into sensors.c, it has no reason to be MLX-specific
// i2c_dev will then need to be a global variable in sensors.c and extern in sensors.h
/*void MLX90641_I2CInit()
{   
    i2c_dev = DEVICE_DT_GET(DT_NODELABEL(i2c0));
    i2c_configure(i2c_dev, I2C_SPEED_SET(I2C_SPEED_FAST));
    // set MLX90641 refresh rate
}*/

int MLX90641_I2CGeneralReset(void)  // this function ideally should not be used since it affects all devices on I2C line
{    
    int ack;

    uint8_t cmd = 0x06;

    ack = i2c_write(i2c_dev, &cmd, 1, 0x0000);  // writing 0x06 to address 0x00 should reset all devices on I2C
    
    if (ack != 0)
    {
        return -1;
    }         
  
    k_sleep(K_USEC(50));    // idk why this sleep is here
    
    return 0;
}

int MLX90641_I2CRead(uint8_t slaveAddr, uint16_t startAddress, uint16_t nMemAddressRead, uint16_t *data)
{
    //LOG_INF("slaveAddr: %d startAddress: %d nMemAddressRead: %d *data: %p", slaveAddr, startAddress, nMemAddressRead, data);
                           
    int ack = 0;                               
    int cnt = 0;
    int i = 0;
    char cmd[2] = {0,0};
    char i2cData[1664] = {0};
    uint16_t *p;
    
    p = data;
    cmd[0] = startAddress >> 8;
    cmd[1] = startAddress & 0x00FF;

    //ack = i2c_write(i2c_dev, cmd, 2, slaveAddr);     
    //ack = i2c_read(i2c_dev, i2cData, 2*nMemAddressRead, slaveAddr);
    ack = i2c_write_read(i2c_dev, slaveAddr, cmd, 2, i2cData, 2*nMemAddressRead);
    
    if (ack != 0x00)
    {
        return -1; 
    }            
    
    for(cnt=0; cnt < nMemAddressRead; cnt++)    // this just turns uint8_t[2*nMemAddressRead] into uint16_t[nMemAddressRead]
    {
        i = cnt << 1;
        *p++ = (uint16_t)i2cData[i]*256 + (uint16_t)i2cData[i+1];
    }
    
    return 0;   
} 

void MLX90641_I2CFreqSet(int freq)  // unused, we set frequency on init
{
    
}

int MLX90641_I2CWrite(uint8_t slaveAddr, uint16_t writeAddress, uint16_t data)
{
    int ack = 0;
    char cmd[4] = {0,0,0,0};
    static uint16_t dataCheck;
    
    cmd[0] = writeAddress >> 8;
    cmd[1] = writeAddress & 0x00FF;
    cmd[2] = data >> 8;
    cmd[3] = data & 0x00FF;
    
    k_sleep(K_USEC(5));

    ack = i2c_write(i2c_dev, cmd, 4, slaveAddr);
    
    if (ack != 0x00)
    {
        return -1;
    }          
    
    MLX90641_I2CRead(slaveAddr, writeAddress, 1, &dataCheck);
    
    if (dataCheck != data)
    {
        return -2;
    }    
    
    return 0;
}
```

## src/MLX90641_I2C_Driver.h
```c
#ifndef _MLX90641_I2C_Driver_H_
#define _MLX90641_I2C_Driver_H_

#include <stdint.h>

#define MLX90641_ADDR 0x33

    void MLX90641_I2CInit(void);
    int MLX90641_I2CGeneralReset(void);
    int MLX90641_I2CRead(uint8_t slaveAddr,uint16_t startAddress, uint16_t nMemAddressRead, uint16_t *data);
    int MLX90641_I2CWrite(uint8_t slaveAddr,uint16_t writeAddress, uint16_t data);
    void MLX90641_I2CFreqSet(int freq);
#endif
```

## src/sensors.c
```c
#include <zephyr.h>
#include <drivers/i2c.h>

#include <math.h>

#include <logging/log.h>
LOG_MODULE_DECLARE(TTPMS);

#include "sensors.h"
#include "MLX90641_API.h"
#include "MLX90641_I2C_Driver.h"

const struct device *i2c_dev;    // the Zephyr I2C device instance		

static float mlx90641To[192];
paramsMLX90641 mlx90641;
float vdd;
float Ta;

// The below floats should be added as BLE characteristics for tuning

float ta_shift = 8;			// Default shift for MLX90641 in open air
float emissivity = 0.95;	// Tune this with testing

//0th bit = connected   1th bit = connect procedure required    2th bit = disconnect procedure required    3th bit = temp_freq update required
uint8_t connection_status;

// Temp values can range from -20 C (0) to 300 C (32000). The last two digits are decimal places (ie 150.43 C = 15043)
// Signed ints are annoying so the range is offset to allow some negative temps (ie -20 C = 0, 0 C = 2000, 100 C = 12000).
uint16_t temp[12] = {18000, 18500, 19000, 19500,
					 20000, 20500, 21000, 21500,
					 22000, 22500, 23000, 23500};

uint16_t pressure = 100;

uint16_t battery = 340;		// battery voltage * 100, for example 340 = 3.40v

// frequency of temp sensor updates (0x00 = 0.5Hz, 0x01 = 1Hz, 0x02 = 2Hz, 0x03 = 4Hz, 0x04 = 8Hz, 0x05 = 16Hz (default), 0x06 = 32Hz, 0x07 = 64Hz)
uint8_t temp_freq = 0x05;

uint8_t pressure_freq = 20;	// frequency of pressure sensor updates in Hertz

void i2c_init(void)
{
	i2c_dev = DEVICE_DT_GET(DT_NODELABEL(i2c0));
    i2c_configure(i2c_dev, I2C_SPEED_SET(I2C_SPEED_FAST));
}

void MLX90641_init(void)
{

	int status;
	uint16_t eeMLX90641[832];

    status = MLX90641_DumpEE(MLX90641_ADDR, eeMLX90641);
    if (status != 0) {
        LOG_INF("Failed to load system parameters, MLX90641_DumpEE() returned %d", status);
    }
	
    status = MLX90641_ExtractParameters(eeMLX90641, &mlx90641);
    if (status != 0) {
        LOG_INF("Parameter extraction failed, MLX90641_ExtractParameters() returned %d", status);
    }

	status = MLX90641_SetRefreshRate(MLX90641_ADDR, temp_freq);
	if (status != 0) {
        LOG_INF("Setting refresh rate failed, MLX90641_SetRefreshRate() returned %d", status);
    }
}

void temp_read(void)
{
	int status;

	uint16_t mlx90641Frame[242];
	status = MLX90641_GetFrameData(MLX90641_ADDR, mlx90641Frame);
	if (status < 0) {
		LOG_INF("GetFrame Error: %d", status);
	}

	vdd = MLX90641_GetVdd(mlx90641Frame, &mlx90641);
	battery = round(vdd)*100;

	Ta = MLX90641_GetTa(mlx90641Frame, &mlx90641);

	float tr = Ta - ta_shift; //Reflected temperature based on the sensor ambient temperature

	MLX90641_CalculateTo(mlx90641Frame, &mlx90641, emissivity, tr, mlx90641To);

	// Average nearby pixels to get the 12 measurement points
	// Only middle four rows are used. Rightmost column is not used.
	// Also converts float to offset int system (see temp[] comment)
	for (int i = 0; i < 12; i++)
	{
		temp[i] = round(((	mlx90641To[64 + i] + mlx90641To[65 + i] +
			   				mlx90641To[80 + i] + mlx90641To[81 + i] +
			   		 		mlx90641To[96 + i] + mlx90641To[97 + i] +
			   		 		mlx90641To[80 + i] + mlx90641To[81 + i]) / 8 + 20) * 100);
	}
	//LOG_INF("temp[12]: %d %d %d %d %d %d %d %d %d %d %d %d", temp[0], temp[1], temp[2], temp[3], temp[4], temp[5],
	//														 temp[6], temp[7], temp[8], temp[9], temp[10], temp[11]);

	if (bitcheck(connection_status, 3))	// check if MLX90641 refresh rate needs to be updated
	{
		status = MLX90641_SetRefreshRate(MLX90641_ADDR, temp_freq);
		if (status != 0) {
        	LOG_INF("Setting refresh rate failed, MLX90641_SetRefreshRate() returned %d", status);
    	} else {
			bitclear(connection_status, 3);
		}
	}
    
}

void pressure_read(void)
{
    pressure++;
}
```

## src/sensors.h
```c
/*
    sensors contains the actual sensor data and related functions
*/

#include <zephyr/types.h>

#define bitset(byte,nbit)   ((byte) |=  (1<<(nbit)))
#define bitclear(byte,nbit) ((byte) &= ~(1<<(nbit)))
#define bitflip(byte,nbit)  ((byte) ^=  (1<<(nbit)))
#define bitcheck(byte,nbit) ((byte) &   (1<<(nbit)))

extern const struct device *i2c_dev;    // the Zephyr I2C device instance

//0th bit = connected   1th bit = connect procedure required    2th bit = disconnect procedure required    3th bit = temp_freq update required
extern uint8_t connection_status;

// Temp values can range from -20 C (0) to 300 C (32000). The last two digits are decimal places (ie 150.43 C = 15043)
// Signed ints are annoying so the range is offset to allow some negative temps (ie -20 C = 0, 0 C = 2000, 100 C = 12000).
extern uint16_t temp[12];

extern uint16_t pressure;

extern uint16_t battery;		// battery voltage * 100, for example 340 = 3.40v

// frequency of temp sensor updates (0x00 = 0.5Hz, 0x01 = 1Hz, 0x02 = 2Hz, 0x03 = 4Hz, 0x04 = 8Hz, 0x05 = 16Hz (default), 0x06 = 32Hz, 0x07 = 64Hz)
extern uint8_t temp_freq;

extern uint8_t pressure_freq;	// frequency of pressure sensor updates in Hertz

void i2c_init(void);

void MLX90641_init(void);

void temp_read(void);

void pressure_read(void);
```

## src/ttpms_service.c
```c
#include <stddef.h>
#include <string.h>
#include <errno.h>
#include <sys/byteorder.h>
#include <zephyr.h>

#include <bluetooth/uuid.h>
#include <bluetooth/bluetooth.h>
#include <bluetooth/hci.h>
#include <bluetooth/conn.h>
#include <bluetooth/uuid.h>
#include <bluetooth/gatt.h>

#include <logging/log.h>
LOG_MODULE_DECLARE(TTPMS);

#include "ttpms_service.h"
#include "MLX90641_I2C_Driver.h"

// UUID part values are in ttpms_service.h

// Base UUID for the TTPMS service
static struct bt_uuid_128 ttpms_uuid = BT_UUID_INIT_128(TTPMS_BASE_UUID);

// UUID for the Temperature characteristic
static struct bt_uuid_128 temperature_uuid = BT_UUID_INIT_128(
	BT_UUID_128_ENCODE(UUID_PART_1, TTPMS_LOCATION, TEMPERATURE_UUID_PART, UUID_PART_4, UUID_PART_5));

// UUID for the Pressure characteristic
static struct bt_uuid_128 pressure_uuid = BT_UUID_INIT_128(
	BT_UUID_128_ENCODE(UUID_PART_1, TTPMS_LOCATION, PRESSURE_UUID_PART, UUID_PART_4, UUID_PART_5));

// UUID for the Battery characteristic
static struct bt_uuid_128 battery_uuid = BT_UUID_INIT_128(
	BT_UUID_128_ENCODE(UUID_PART_1, TTPMS_LOCATION, BATTERY_UUID_PART, UUID_PART_4, UUID_PART_5));

// UUID for the Temperature Frequency characteristic
static struct bt_uuid_128 temp_freq_uuid = BT_UUID_INIT_128(
	BT_UUID_128_ENCODE(UUID_PART_1, TTPMS_LOCATION, TEMP_FREQ_UUID_PART, UUID_PART_4, UUID_PART_5));

// UUID for the Pressure Frequency characteristic
static struct bt_uuid_128 pressure_freq_uuid = BT_UUID_INIT_128(
	BT_UUID_128_ENCODE(UUID_PART_1, TTPMS_LOCATION, PRESSURE_FREQ_UUID_PART, UUID_PART_4, UUID_PART_5));

static ssize_t read_temp(struct bt_conn *conn, const struct bt_gatt_attr *attr,
			void *buf, uint16_t len, uint16_t offset)
{
	const char *value = attr->user_data;

	return bt_gatt_attr_read(conn, attr, buf, len, offset, value,
				 sizeof(temp));
}

static ssize_t read_pressure(struct bt_conn *conn, const struct bt_gatt_attr *attr,
			void *buf, uint16_t len, uint16_t offset)
{
	const char *value = attr->user_data;

	return bt_gatt_attr_read(conn, attr, buf, len, offset, value,
				 sizeof(pressure));
}

static ssize_t read_battery(struct bt_conn *conn, const struct bt_gatt_attr *attr,
			void *buf, uint16_t len, uint16_t offset)
{
	const char *value = attr->user_data;

	return bt_gatt_attr_read(conn, attr, buf, len, offset, value,
				 sizeof(battery));
}

static ssize_t read_temp_freq(struct bt_conn *conn, const struct bt_gatt_attr *attr,
			void *buf, uint16_t len, uint16_t offset)
{
	const char *value = attr->user_data;

	return bt_gatt_attr_read(conn, attr, buf, len, offset, value,
				 sizeof(temp_freq));
}

static ssize_t write_temp_freq(struct bt_conn *conn, const struct bt_gatt_attr *attr,
			 const void *buf, uint16_t len, uint16_t offset, uint8_t flags)
{
	uint8_t *value = attr->user_data;	// pointer to temp_freq variable?
	memcpy(value + offset, buf, len);	// write data from BLE into temp_freq variable?
	value[offset + len] = 0;
	bitset(connection_status, 3);	// set temp_freq update required bit
	return len;
}

static ssize_t read_pressure_freq(struct bt_conn *conn, const struct bt_gatt_attr *attr,
			void *buf, uint16_t len, uint16_t offset)
{
	const char *value = attr->user_data;

	return bt_gatt_attr_read(conn, attr, buf, len, offset, value,
				 sizeof(pressure_freq));
}

static ssize_t write_pressure_freq(struct bt_conn *conn, const struct bt_gatt_attr *attr,
			 const void *buf, uint16_t len, uint16_t offset, uint8_t flags)
{
	uint8_t *value = attr->user_data;
	memcpy(value + offset, buf, len);
	value[offset + len] = 0;
	return len;
}

static void temp_ccc_cfg_changed(const struct bt_gatt_attr *attr, uint16_t value)
{
	ARG_UNUSED(attr);

	bool notif_enabled = (value == BT_GATT_CCC_NOTIFY);

	LOG_INF("Temp Notifications %s", notif_enabled ? "enabled" : "disabled");
}

static void pressure_ccc_cfg_changed(const struct bt_gatt_attr *attr, uint16_t value)
{
	ARG_UNUSED(attr);

	bool notif_enabled = (value == BT_GATT_CCC_NOTIFY);

	LOG_INF("Pressure Notifications %s", notif_enabled ? "enabled" : "disabled");
}

/* Vendor Primary Service Declaration */
BT_GATT_SERVICE_DEFINE(ttpms_svc,
	BT_GATT_PRIMARY_SERVICE(&ttpms_uuid),
	BT_GATT_CHARACTERISTIC(&temperature_uuid.uuid,
			       BT_GATT_CHRC_READ | BT_GATT_CHRC_NOTIFY,
			       BT_GATT_PERM_READ,
			       read_temp, NULL, temp),
	BT_GATT_CCC(temp_ccc_cfg_changed,				// This CCC allows notifications to be enabled for the above characteristic?
		    BT_GATT_PERM_READ | BT_GATT_PERM_WRITE),
    BT_GATT_CHARACTERISTIC(&pressure_uuid.uuid,
			       BT_GATT_CHRC_READ | BT_GATT_CHRC_NOTIFY,
			       BT_GATT_PERM_READ,
			       read_pressure, NULL, &pressure),
	BT_GATT_CCC(pressure_ccc_cfg_changed,			// This CCC allows notifications to be enabled for the above characteristic?
		    BT_GATT_PERM_READ | BT_GATT_PERM_WRITE),
	BT_GATT_CHARACTERISTIC(&battery_uuid.uuid,
			       BT_GATT_CHRC_READ,
			       BT_GATT_PERM_READ,
			       read_battery, NULL, &battery),
	BT_GATT_CHARACTERISTIC(&temp_freq_uuid.uuid,
			       BT_GATT_CHRC_READ | BT_GATT_CHRC_WRITE,
			       BT_GATT_PERM_READ | BT_GATT_PERM_WRITE,
			       read_temp_freq, write_temp_freq, &temp_freq),
    BT_GATT_CHARACTERISTIC(&pressure_freq_uuid.uuid,
			       BT_GATT_CHRC_READ | BT_GATT_CHRC_WRITE,
			       BT_GATT_PERM_READ | BT_GATT_PERM_WRITE,
			       read_pressure_freq, write_pressure_freq, &pressure_freq),
);

static const struct bt_data ad[] = {										// Advertisement:
	BT_DATA_BYTES(BT_DATA_FLAGS, (BT_LE_AD_GENERAL | BT_LE_AD_NO_BREDR)),	// General Discoverable (no timeout), BR/EDR not supported
	BT_DATA_BYTES(BT_DATA_UUID128_ALL, TTPMS_BASE_UUID),					// Our service
};

void mtu_updated(struct bt_conn *conn, uint16_t tx, uint16_t rx)
{
	LOG_INF("Updated MTU: TX: %d RX: %d bytes", tx, rx);
}

static struct bt_gatt_cb gatt_callbacks = {
	.att_mtu_updated = mtu_updated
};

static void connected(struct bt_conn *conn, uint8_t err)
{
	if (err) {
		LOG_INF("Connection failed (err 0x%02x)", err);
	} else {
		LOG_INF("Connected");
		bitset(connection_status, 1);	// set connection procedure required bit (1th bit)
		bitset(connection_status, 0);	// set connection status bit (0th bit)
	}
}

static void disconnected(struct bt_conn *conn, uint8_t reason)
{
	LOG_INF("Disconnected (reason 0x%02x)", reason);
	bitclear(connection_status, 0);	// clear connection status bit (0th bit)
	bitset(connection_status, 2);	// set disconnection procedure required bit (2th bit)
}

BT_CONN_CB_DEFINE(conn_callbacks) = {
	.connected = connected,
	.disconnected = disconnected,
};

static void bt_ready(void)
{
	int err;

	LOG_INF("Bluetooth initialized");

	err = bt_le_adv_start(BT_LE_ADV_CONN_NAME, ad, ARRAY_SIZE(ad), NULL, 0);
	if (err) {
		LOG_INF("Advertising failed to start (err %d)", err);
		return;
	}

	LOG_INF("Advertising successfully started");
}

void ttpms_service_init(void)
{
    int err;

	err = bt_enable(NULL);
	if (err) {
		LOG_INF("Bluetooth init failed (err %d)", err);
		return;
	}

	bt_ready();
	bt_gatt_cb_register(&gatt_callbacks);
}

void ttpms_temp_notify(void)
{
    bt_gatt_notify(NULL, &ttpms_svc.attrs[2], temp, sizeof(temp));
}

void ttpms_pressure_notify(void)
{
    bt_gatt_notify(NULL, &ttpms_svc.attrs[4], &pressure, sizeof(pressure));
}
```

## src/ttpms_service.h
```c
/*
    ttpms_service contains all the Bluetooth-related functions of the TTPMS system,
    such as the GATT TTPMS service
*/

#include <zephyr/types.h>

#include "sensors.h"

#define UUID_PART_1				    0x7f0413db		// randomly generated
#define TTPMS_LOCATION			    0xFF01 			// 0xFF01 = FL    0xFF02 = FR    0xFF03 = RL    0xFF04 = RR
#define BASE_UUID_PART			    0x00FF			// used for base service UUID
#define TEMPERATURE_UUID_PART	    0x01FF			// used for temperature characteristic UUID
#define PRESSURE_UUID_PART			0x02FF			// used for pressure characteristic UUID
#define BATTERY_UUID_PART		    0x03FF			// used for battery characteristic UUID
#define TEMP_FREQ_UUID_PART		    0x04FF			// used for temperature frequency characteristic UUID
#define PRESSURE_FREQ_UUID_PART		0x05FF			// used for pressure frequency characteristic UUID
#define UUID_PART_4				    0x9c11			// randomly generated
#define UUID_PART_5				    0x8f8275ff78c4	// randomly generated

#define TTPMS_BASE_UUID BT_UUID_128_ENCODE(UUID_PART_1, TTPMS_LOCATION, BASE_UUID_PART, UUID_PART_4, UUID_PART_5)

void ttpms_service_init(void);

void ttpms_temp_notify(void);

void ttpms_pressure_notify(void);
```
