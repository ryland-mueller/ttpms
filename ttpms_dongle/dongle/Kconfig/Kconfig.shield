## ttpms_dongle/dongle/Kconfig/Kconfig.shield.defconfig
```kconfig
osource "c:/Users/Ryland/OneDrive/NCS_Projects/peripheral/boards/shields/*/Kconfig.defconfig"
osource "C:/Users/Ryland/ncs/v1.8.0/nrf/boards/shields/*/Kconfig.defconfig"
```

## ttpms_receiver/dongle/Kconfig/Kconfig.shield.defconfig
```kconfig
osource "c:/Users/Ryland/OneDrive/NCS_Projects/display/boards/shields/*/Kconfig.defconfig"
osource "C:/Users/Ryland/ncs/v1.8.0/nrf/boards/shields/*/Kconfig.defconfig"
```
